//#include "lcd.h"
#include <avr/io.h>
#include <avr/interrupt.h>
#define F_CPU 16000000UL
#include <util/delay.h>


#define SetBit(x,y)  (x|=(1<<y))
#define ClrBit(x,y)  (x&=~(1<<y))


unsigned char font[95][5] = {            /* 5x7 ASCII character font */
	{0x00, 0x00, 0x00, 0x00, 0x00},    /* 0x20 space */
	{0x00, 0x00, 0x4f, 0x00, 0x00},    /* 0x21 ! */
	{0x00, 0x07, 0x00, 0x07, 0x00},    /* 0x22 " */
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	{0x08, 0x04, 0x08, 0x10, 0x08}};   /* 0x7e ~ */


void cmd_l( unsigned char cmd )	
{
	SetBit(PORTE,5);	// E
	_delay_us(10);
	ClrBit(PORTE,4);	// RS
	ClrBit(PORTE,6);	// CS2
	SetBit(PORTE,7);	// CS1
	PORTA = cmd ;		
	_delay_us(10);
	ClrBit(PORTE,5);	// E
}

void cmd_r( unsigned char cmd )
{
	SetBit(PORTE,5);	// E
	_delay_us(10);
	ClrBit(PORTE,4);	// RS
	SetBit(PORTE,6);	// CS2
	ClrBit(PORTE,7);	// CS1
	PORTA = cmd ;
	_delay_us(10);
	ClrBit(PORTE,5);	// E
}

void cmd_lr( unsigned char cmd )
{
	SetBit(PORTE,5);	// E
	_delay_us(10);
	ClrBit(PORTE,4);	// RS
	SetBit(PORTE,6);	// CS2
	SetBit(PORTE,7);	// CS1
	PORTA = cmd ;
	_delay_us(10);
	ClrBit(PORTE,5);	// E
}

void data_l( unsigned char data )          
{
	SetBit(PORTE,5);	// E
	_delay_us(10);
	SetBit(PORTE,4);	// RS
	ClrBit(PORTE,6);	// CS2
	SetBit(PORTE,7);	// CS1
	PORTA = data ; 
	_delay_us(10);
	ClrBit(PORTE,5);	// E
}

void data_r( unsigned char data )
{
	SetBit(PORTE,5);	// E
	_delay_us(10);
	SetBit(PORTE,4);	// RS
	SetBit(PORTE,6);	// CS2
	ClrBit(PORTE,7);	// CS1
	PORTA = data ;
	_delay_us(10);
	ClrBit(PORTE,5);	// E
}

void data_lr( unsigned char data )
{
	SetBit(PORTE,5);	// E
	_delay_us(10);
	SetBit(PORTE,4);	// RS
	SetBit(PORTE,6);	// CS2
	SetBit(PORTE,7);	// CS1
	PORTA = data ;
	_delay_us(10);
	ClrBit(PORTE,5);	// E
}

void display_char(unsigned char x, unsigned char y, unsigned char character)
{
	unsigned char i;
	
	cmd_lr(0xB8+x);     // x address
	if( y < 10 )
		cmd_l(0x40+y*6+4); // y address	
	else
		cmd_r(0x40+(y-10)*6); // y address
		
	for(i = 0; i < 5; i++)
	{
		if(y < 10)                 
			data_l(font[character-0x20][i]);
		else                           
			data_r(font[character-0x20][i]);
	}			
		
	if(y < 10)
		data_l(0x00);                   
	else
		data_r(0x00); 				                  	
}

void display_string(unsigned char x, unsigned char y, unsigned char *string)
{
	unsigned char i;
	
	cmd_lr(0xB8+x);     // x address
	if( y < 10 )
		cmd_l(0x40+y*6+4); // y address
	else
		cmd_r(0x40+(y-10)*6); // y address
	
	while( *string != '\0' ){
		if( y == 10 ){
			cmd_r(0x40);
		}
		for(i = 0; i < 5; i++){
			if(y < 10)					   
				data_l(font[*string-0x20][i]);
			else                           
				data_r(font[*string-0x20][i]);
		}
	
		if(y < 10)
			data_l(0x00);                    
		else
			data_r(0x00);
			
		string++;
		y++;
	}	
}

void lcd_clear()
{
	unsigned char i, j, x, y;
	x = 0xB8;                         /* X start address */
	y = 0x40;                         /* Y start address */
	for(i = 0; i < 8; i++)
	{
		cmd_lr(x);    cmd_lr(y);
		for(j = 0; j < 64; j++)
			data_lr(0x00);           /* clear CS1 and CS2 */
		x++;
	}
	//HW: Clear ScreenBuffer as well
}

void fill_char_xy(unsigned char x_char, unsigned char y, unsigned char data)
{
	cmd_lr( 0xB8 + x_char);         // X address
	if(y <= 63)
	{
		cmd_l( 0x40 + y);      // CS1 Y address
		data_l(data);
	}
	else
	{
		cmd_r( 0x40 + y - 64); // CS2 Y address
		data_r(data);
	}
}

void InitScreenBuffer( unsigned char ScreenBuffer[8][128] )
{
	unsigned int i, j;
	
	for(i = 0 ; i < 8; i++){
		for(j = 0 ; j < 128; j++){
			ScreenBuffer[i][j] = 0;
		}			
	}
}

void GLCD_Dot(unsigned char ScreenBuffer[8][128], unsigned char x, unsigned char y)
{
	unsigned char x_char, xx, dot_data;
	
	//Error: out of screen
	if((x >= 64) || (y >= 128)) return; 
	
	x_char = x / 8;    // calculate x address (in terms of char)
	xx = x % 8;        //                     (within a char)
	
	dot_data = (1<<xx);                  // Make a dot
	ScreenBuffer[x_char][y] |= dot_data; // OR old data with dot data
	// draw on GLCD screen
	fill_char_xy(x_char, y, ScreenBuffer[x_char][y]);          
}

void GLCD_Line(unsigned char ScreenBuffer[8][128], unsigned char x1,unsigned char y1,unsigned char x2,unsigned char y2)
{
	int x, y;
	if(y1 != y2)    // if y1 != y2, y is variable
	{
		if(y1 < y2)    //              x is function
		{
			for(y = y1; y <= y2; y++)
			{
				x = x1 + (y - y1)*(x2 - x1)/(y2 - y1);
				GLCD_Dot(ScreenBuffer,x,y);
			}
		}
		else
		{
			for(y = y1; y >= y2; y--)
			{
				x = x1 + (y - y1)*(x2 - x1)/(y2 - y1);
				GLCD_Dot(ScreenBuffer,x,y);
			}
		}
	}
	else if(x1 != x2)   // if x1 != x2, x is variable
	{
		if(x1 < x2)    //              y is function
		{
			for(x = x1; x <= x2; x++)
			{ y = y1 + (x - x1)*(y2 - y1)/(x2 - x1);
				GLCD_Dot(ScreenBuffer,x,y);
			}
		}
		else
		{
			for(x = x1; x >= x2; x--)
			{
				y = y1 + (x - x1)*(y2 - y1)/(x2 - x1);
				GLCD_Dot(ScreenBuffer,x,y);
			}
		}
	}
	else                  // if x1 == x2 and y1 == y2,
	{
		GLCD_Dot(ScreenBuffer,x1,y1);  //             it is a dot
	}
}

void GLCD_Rectangle(unsigned char ScreenBuffer[8][128],unsigned char x1,unsigned char y1,unsigned char x2,unsigned char y2)
{
	//Fill your code here
	
}

void GLCD_RectangleBlack(unsigned char ScreenBuffer[8][128],unsigned char x1,unsigned char y1,unsigned char x2,unsigned char y2) {
	//HW
}

void GLCD_Circle(unsigned char ScreenBuffer[8][128],unsigned char x1,unsigned char y1,unsigned char r)
{
	int x, y;
	float s;
	for(y = y1 - r*3/4; y <= y1 + r*3/4; y++) // draw with y variable
	{
		s = sqrt(r*r - (y-y1)*(y-y1)) + 0.5;
		x = x1 + (unsigned char)s;
		GLCD_Dot(ScreenBuffer,x,y);
		x = x1 - (unsigned char)s;
		GLCD_Dot(ScreenBuffer,x,y);
	}
	for(x = x1 - r*3/4; x <= x1 + r*3/4; x++) // draw with x variable
	{
		s = sqrt(r*r - (x-x1)*(x-x1)) + 0.5;
		y = y1 + (unsigned char)s;
		GLCD_Dot(ScreenBuffer,x,y);
		y = y1 - (unsigned char)s;
		GLCD_Dot(ScreenBuffer,x,y);
	}
}

unsigned char sec0, sec1, sec2, sec3;

int main(void) 
{	
	//Initialization
	DDRA = 0xFF;
	PORTB = 0xFF; DDRB = 0xFF;
	DDRD = 0x0;
	DDRE = 0xFF;
	PORTG = 0x0; DDRG = 0xFF;

	cmd_lr( 0x3F ); //DISP ON   
	cmd_lr( 0xB8 );
	cmd_lr( 0x40 );
	
	lcd_clear();
	display_string(0, 0, "Clock Interrupt Test");
	
	TCNT1H = 0xB;
	TCNT1L = 0xDC;	
	TCCR1A = 0x0;
	TCCR1B = 0x04;
	
	TIMSK = (1<<TOIE1);
	sei();
	
	sec3 = 0;
	sec2 = 0;
	sec1 = 0;
	sec0 = 0;

	while(1){
		display_char(1, 0, sec3+0x30);
		display_char(1, 1, sec2+0x30);
		display_char(1, 2, 0x3a);
		display_char(1, 3, sec1+0x30);
		display_char(1, 4, sec0+0x30);
	}			
}

ISR(TIMER1_OVF_vect){
	sec0++;
	if(sec0 == 10){
		sec0 = 0;
		sec1++;
		if(sec1 == 6){
			sec1 = 0;
			sec2++;
			if(sec2 == 10) {
				sec2 = 0;
				sec3++;
				if (sec3 == 6) {
					sec3 = 0;
				}
			}
		}
	}		
}
.INCLUDE"M128DEF.INC"
.ORG 0
	LDI R16,HIGH(RAMEND)	;load SPH
	OUT SPH,R16
	LDI R16,LOW(RAMEND)	;load SPL
	OUT SPL,R16
	LDI R16,0xFF
	OUT  DDRB,R16
	LDI R16,0x0
	OUT  DDRD,R16

LOOP: IN   R16,PIND  ;R16 = PIND, LOOP 1 start
	COM	 R16	; complement R16
	BRNE ELSEA
	LDI  R16,0x5F	;load R16 with 0x5F
	RJMP ELSEENDA
ELSEA:	LDI  R16,0xF5	;load R16 with 0xF5
ELSEENDA:	OUT  PORTB,R16 ;PORTB = R16
	RCALL DELAY

	IN	 R16,PIND	;LOOP 2 start
	COM	 R16
	BRNE ELSEB
	LDI	 R16,0xAF
	RJMP ELSEENDB
ELSEB:	LDI	 R16,0xFA
ELSEENDB:	OUT	 PORTB,R16
	RCALL DELAY
	RJMP LOOP


DELAY: 	
	LDI	R20,64
L1:	LDI	R21,200
L2:	LDI	R22,250 ;   
L3:	
	NOP
	NOP
	DEC	R22
	BRNE	L3
	DEC	R21
	BRNE	L2
	DEC	R20
	BRNE	L1
	RET


